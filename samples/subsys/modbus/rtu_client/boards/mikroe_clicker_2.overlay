/* SPDX-FileCopyrightText: Copyright (c) 2026 ID8 Engineering AB */
/* SPDX-License-Identifier: Apache-2.0 */

/*
 * Keep this board-specific overlay minimal and aligned with RS485 bus speed.
 * Use generic mikroBUS aliases so socket selection is controlled by board DTS.
 */
&mikrobus_uart {
	status = "okay";
	current-speed = <9600>;
};
