## samples/sensor/hts221/sample.yaml
```yaml
sample:
  name: HTS221 Temperature and Humidity Monitor
common:
  harness: console
  integration_platforms:
    - disco_l475_iot1
  filter: dt_compat_enabled("st,hts221")
  tags: sensors
  depends_on:
    - i2c
    - hts221
  harness_config:
    type: multi_line
    ordered: true
    regex:
      - "Observation:(.*)"
      - "Temperature:(.*) C"
      - "Relative Humidity:(.*)%"
tests:
  sample.sensor.hts221:
    extra_configs:
      - CONFIG_HTS221_TRIGGER_NONE=y
  sample.sensor.hts221.trigger:
    extra_configs:
      - CONFIG_HTS221_TRIGGER_OWN_THREAD=y
    platform_exclude:
      - b_u585i_iot02a
  sample.sensor.hts221.shields:
    platform_allow:
      - mikroe_clicker_2
    integration_platforms:
      - mikroe_clicker_2
    extra_args:
      - platform:mikroe_clicker_2:SHIELD="mikroe_temp_hum_click"
    extra_configs:
      - CONFIG_HTS221_TRIGGER_NONE=y
```
